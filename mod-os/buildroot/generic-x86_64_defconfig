## mod-os/buildroot/generic-x86_64_defconfig
```kconfig
BR2_x86_64=y
BR2_DL_DIR="$(DOWNLOAD_PATH)"
BR2_OPTIMIZE_3=y
BR2_TOOLCHAIN_EXTERNAL=y
BR2_TOOLCHAIN_EXTERNAL_CUSTOM=y
BR2_TOOLCHAIN_EXTERNAL_PATH="$(TOOLCHAIN_PATH)"
BR2_TOOLCHAIN_EXTERNAL_CUSTOM_PREFIX="x86_64-modaudio.generic-linux-gnu"
BR2_TOOLCHAIN_EXTERNAL_GCC_9=y
BR2_TOOLCHAIN_EXTERNAL_HEADERS_5_15=y
BR2_TOOLCHAIN_EXTERNAL_CUSTOM_GLIBC=y
# BR2_TOOLCHAIN_EXTERNAL_INET_RPC is not set
BR2_TOOLCHAIN_EXTERNAL_CXX=y
BR2_GENERATE_LOCALE="en_US.UTF-8"
BR2_TARGET_OPTIMIZATION="-mtune=generic -msse -msse2 -mfpmath=sse -ffast-math -fno-finite-math-only -fomit-frame-pointer -fprefetch-loop-arrays -funroll-loops -funsafe-loop-optimizations -D__MOD_DEVICES__ -D_MOD_DEVICE_GENERIC_X86_64 -Wl,-O1,--as-needed,--strip-all"
BR2_TARGET_LDFLAGS="-Wl,-O1,--as-needed,--strip-all"
BR2_TARGET_GENERIC_HOSTNAME=""
BR2_TARGET_GENERIC_ISSUE=""
BR2_INIT_SYSTEMD=y
BR2_ROOTFS_DEVICE_TABLE=""
+BR2_TARGET_GENERIC_ROOT_PASSWD="mod"
+# BR2_TARGET_GENERIC_GETTY is not set
+# BR2_TARGET_GENERIC_REMOUNT_ROOTFS_RW is not set
+BR2_PACKAGE_BUSYBOX_CONFIG="${HOME}/busybox.config"
+BR2_PACKAGE_ALSA_UTILS=y
+BR2_PACKAGE_ALSA_UTILS_AMIXER=y
+BR2_PACKAGE_ALSA_UTILS_APLAY=y
BR2_PACKAGE_VALGRIND=y
BR2_PACKAGE_QT5=y
BR2_PACKAGE_QT5BASE_LICENSE_APPROVED=y
BR2_PACKAGE_QT5BASE_ICU=y
BR2_PACKAGE_LIBLO=y
BR2_PACKAGE_LIBXML2=y
BR2_PACKAGE_MXML=y
BR2_PACKAGE_ARMADILLO=y
BR2_PACKAGE_BOOST_ATOMIC=y
BR2_PACKAGE_BOOST_CHRONO=y
BR2_PACKAGE_BOOST_CONTAINER=y
BR2_PACKAGE_BOOST_DATE_TIME=y
BR2_PACKAGE_BOOST_EXCEPTION=y
BR2_PACKAGE_BOOST_FILESYSTEM=y
BR2_PACKAGE_BOOST_GRAPH=y
BR2_PACKAGE_BOOST_GRAPH_PARALLEL=y
BR2_PACKAGE_BOOST_IOSTREAMS=y
BR2_PACKAGE_BOOST_LOCALE=y
BR2_PACKAGE_BOOST_MATH=y
BR2_PACKAGE_BOOST_MPI=y
BR2_PACKAGE_BOOST_PROGRAM_OPTIONS=y
BR2_PACKAGE_BOOST_RANDOM=y
BR2_PACKAGE_BOOST_REGEX=y
BR2_PACKAGE_BOOST_SERIALIZATION=y
BR2_PACKAGE_BOOST_SIGNALS=y
BR2_PACKAGE_BOOST_SYSTEM=y
BR2_PACKAGE_BOOST_TEST=y
BR2_PACKAGE_BOOST_THREAD=y
BR2_PACKAGE_BOOST_TIMER=y
BR2_PACKAGE_BOOST_WAVE=y
BR2_PACKAGE_EIGEN=y
BR2_PACKAGE_FFTW=y
BR2_PACKAGE_FFTW_FAST=y
BR2_PACKAGE_GLIBMM=y
BR2_PACKAGE_BASH=y
BR2_PACKAGE_ACL=y
BR2_PACKAGE_UTIL_LINUX_KILL=y
BR2_TARGET_ROOTFS_EXT2=y

# BR2_TARGET_ROOTFS_TAR is not set
BR2_PACKAGE_CARLA_BACKEND=y
BR2_PACKAGE_FLUIDSYNTH=y
BR2_PACKAGE_KXSTUDIO_LV2_EXTENSIONS=y
BR2_PACKAGE_LIBGIG=y
BR2_PACKAGE_LVTK=y
BR2_PACKAGE_LVTK_1=y
BR2_PACKAGE_MOD_LV2_EXTENSIONS=y
BR2_PACKAGE_MOD_PLUGIN_BUILDER=y
BR2_PACKAGE_ZITA_CONVOLVER=y
BR2_PACKAGE_ZITA_RESAMPLER=y
BR2_PACKAGE_BROWSEPY=y
BR2_PACKAGE_MOD_MIDI_MERGER=y
BR2_PACKAGE_MOD_PEAKMETER=y
BR2_PACKAGE_MOD_UI=y
BR2_PACKAGE_MOD_XRUN=y
```
